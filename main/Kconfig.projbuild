## main/Kconfig.projbuild
```kconfig
# ----------------------------------------------------------------------
# GEEKROS Client Configuration
# ----------------------------------------------------------------------

menu "GEEKROS Client Configuration"

    # Basic Configuration
    menu "Basic Configuration"
        # GEEKROS OTA URL
        config GEEKROS_OTA_URL
            string "Default OTA URL"
            default "https://platform.geekros.com/open/ota"
            help
                This is the default OTA server URL for GEEKROS remote firmware upgrades. You can change it to your own OTA service if needed.
        
        # GEEKROS Authorization Configuration
        config GEEKROS_SERVICE_GRK
            string "Authorization GRK"
            default ""
            help
                This is the authorization GRK for GEEKROS Client to access GEEKROS Platform services. You need to set it before using GEEKROS services.
        config GEEKROS_SERVICE_PROJECT_TOKEN
            string "Authorization Project Token"
            default ""
            help
                This is the authorization Project Token for GEEKROS Client to access GEEKROS Platform services. You need to set it before using GEEKROS services.
        
        # System Language
        choice GEEKROS_SYSTEM_LANGUAGE
            prompt "System Language"
            default GEEKROS_SYSTEM_LANGUAGE_ZH_CN
            help
                Select the system language for GEEKROS Client.
            config GEEKROS_SYSTEM_LANGUAGE_EN_US
                bool "English"
            config GEEKROS_SYSTEM_LANGUAGE_ZH_CN
                bool "Chinese"
            config GEEKROS_SYSTEM_LANGUAGE_ZH_TW
                bool "Chinese Traditional"
        endchoice
        
        # System Timezone
        choice GEEKROS_SYSTEM_TIMEZONE
            prompt "Select Timezone"
            default GEEKROS_SYSTEM_TIMEZONE_UTC_NEG_8
            help
                Select the timezone for system time.
            config GEEKROS_SYSTEM_TIMEZONE_UTC_NEG_12
                bool "UTC−12"
            config GEEKROS_SYSTEM_TIMEZONE_UTC_NEG_11
                bool "UTC−11"
            config GEEKROS_SYSTEM_TIMEZONE_UTC_NEG_10
                bool "UTC−10"
            config GEEKROS_SYSTEM_TIMEZONE_UTC_NEG_9_30
                bool "UTC−9:30"
            config GEEKROS_SYSTEM_TIMEZONE_UTC_NEG_9
                bool "UTC−9"
            config GEEKROS_SYSTEM_TIMEZONE_UTC_NEG_8
                bool "UTC−8"
            config GEEKROS_SYSTEM_TIMEZONE_UTC_NEG_7
                bool "UTC−7"
            config GEEKROS_SYSTEM_TIMEZONE_UTC_NEG_6
                bool "UTC−6"
            config GEEKROS_SYSTEM_TIMEZONE_UTC_NEG_5
                bool "UTC−5"
            config GEEKROS_SYSTEM_TIMEZONE_UTC_NEG_4
                bool "UTC−4"
            config GEEKROS_SYSTEM_TIMEZONE_UTC_NEG_3_30
                bool "UTC−3:30"
            config GEEKROS_SYSTEM_TIMEZONE_UTC_NEG_3
                bool "UTC−3"
            config GEEKROS_SYSTEM_TIMEZONE_UTC_NEG_2
                bool "UTC−2"
            config GEEKROS_SYSTEM_TIMEZONE_UTC_NEG_1
                bool "UTC−1"
            config GEEKROS_SYSTEM_TIMEZONE_UTC_0
                bool "UTC±0"
            config GEEKROS_SYSTEM_TIMEZONE_UTC_1
                bool "UTC+1"
            config GEEKROS_SYSTEM_TIMEZONE_UTC_2
                bool "UTC+2"
            config GEEKROS_SYSTEM_TIMEZONE_UTC_3
                bool "UTC+3"
            config GEEKROS_SYSTEM_TIMEZONE_UTC_3_30
                bool "UTC+3:30"
            config GEEKROS_SYSTEM_TIMEZONE_UTC_4
                bool "UTC+4"
            config GEEKROS_SYSTEM_TIMEZONE_UTC_4_30
                bool "UTC+4:30"
            config GEEKROS_SYSTEM_TIMEZONE_UTC_5
                bool "UTC+5"
            config GEEKROS_SYSTEM_TIMEZONE_UTC_5_30
                bool "UTC+5:30"
            config GEEKROS_SYSTEM_TIMEZONE_UTC_5_45
                bool "UTC+5:45"
            config GEEKROS_SYSTEM_TIMEZONE_UTC_6
                bool "UTC+6"
            config GEEKROS_SYSTEM_TIMEZONE_UTC_6_30
                bool "UTC+6:30"
            config GEEKROS_SYSTEM_TIMEZONE_UTC_7
                bool "UTC+7"
            config GEEKROS_SYSTEM_TIMEZONE_UTC_8
                bool "UTC+8"
            config GEEKROS_SYSTEM_TIMEZONE_UTC_8_45
                bool "UTC+8:45"
            config GEEKROS_SYSTEM_TIMEZONE_UTC_9
                bool "UTC+9"
            config GEEKROS_SYSTEM_TIMEZONE_UTC_9_30
                bool "UTC+9:30"
            config GEEKROS_SYSTEM_TIMEZONE_UTC_10
                bool "UTC+10"
            config GEEKROS_SYSTEM_TIMEZONE_UTC_10_30
                bool "UTC+10:30"
            config GEEKROS_SYSTEM_TIMEZONE_UTC_11
                bool "UTC+11"
            config GEEKROS_SYSTEM_TIMEZONE_UTC_12
                bool "UTC+12"
            config GEEKROS_SYSTEM_TIMEZONE_UTC_12_45
                bool "UTC+12:45"
            config GEEKROS_SYSTEM_TIMEZONE_UTC_13
                bool "UTC+13"
            config GEEKROS_SYSTEM_TIMEZONE_UTC_14
                bool "UTC+14"
        endchoice
    endmenu

    # Debug Configuration
    menu "Debug Configuration"
        # Enable Debug Logging
        config GEEKROS_DISABLE_DEBUG_LOGGING
            bool "Disable Debug Logging"
            default y
            help
                Disable debug logging to reduce firmware size. Enable this option for production builds.
    endmenu

    # Development Board Configuration
    menu "Development board configuration"
        # Include auto-generated board configuration
        source "../build/Kconfig.board.auto"

        # Camera Resolution
        choice GEEKROS_CAMERA_RESOLUTION
            prompt "Select Camera Resolution"
            default GEEKROS_CAMERA_RESOLUTION_NONE
            help
                Select the camera resolution for video capture.
            config GEEKROS_CAMERA_RESOLUTION_NONE
                bool "None"
            config GEEKROS_CAMERA_RESOLUTION_320x240
                bool "320x240"
            config GEEKROS_CAMERA_RESOLUTION_640x480
                bool "640x480"
            config GEEKROS_CAMERA_RESOLUTION_1280x720
                bool "1280x720"
        endchoice

        # Camera Frame Rate (FPS)
        config GEEKROS_CAMERA_FPS
            int "Camera Frame Rate (FPS)"
            default 15
            range 1 60
            help
                Camera frames per second.

        # Enable Camera Support
        config GEEKROS_CAMERA_ENABLE_HARDWARE_JPEG_ENCODER
            bool "Enable Hardware JPEG Encoder"
            default y
            depends on SOC_JPEG_ENCODE_SUPPORTED
            help
                Use hardware JPEG encoder on ESP32-P4 to encode image to JPEG.
        
        # Camera Endianness Swap
        config GEEKROS_CAMERA_ENABLE_ENDIANNESS_SWAP
            bool "Enable software camera buffer endianness swapping (USE WITH CAUTION)"
            default n
            depends on !CAMERA_SENSOR_SWAP_PIXEL_BYTE_ORDER
            help
                This option treats the camera buffer as a uint16_t[] array and performs byte-swapping (endianness conversion) on each element.
        
        # Camera Image Rotation
        config GEEKROS_CAMERA_ENABLE_ROTATE_IMAGE
            bool "Enable Camera Image Rotation"
            default n
            help
                Enable camera image rotation, rotate the camera image to the correct orientation.
        
        # Camera Rotation Angle
        if GEEKROS_CAMERA_ENABLE_ROTATE_IMAGE
            # Camera rotation angle
            choice GEEKROS_CAMERA_ROTATION_ANGLE
                prompt "Camera Image Rotation Angle (clockwise)"
                default GEEKROS_CAMERA_ROTATION_ANGLE_0
                help
                    Select the camera image rotation angle.
                config GEEKROS_CAMERA_ROTATION_ANGLE_0
                    bool "0°"
                config GEEKROS_CAMERA_ROTATION_ANGLE_90
                    bool "90°"
                config GEEKROS_CAMERA_ROTATION_ANGLE_180
                    bool "180°"
                config GEEKROS_CAMERA_ROTATION_ANGLE_270
                    bool "270°"
            endchoice   
        endif

        # Display Configuration
        choice GEEKROS_DISPLAY_ENABLE
            prompt "Enable Display"
            default GEEKROS_DISPLAY_NONE
            help
                Select whether the device has a display.
            config GEEKROS_DISPLAY_NONE
                bool "No Display"
            config GEEKROS_DISPLAY_OLED
                bool "OLED Display"
            config GEEKROS_DISPLAY_LCD
                bool "LCD Display"
        endchoice
        
        # Display OLED Type
        choice GEEKROS_OLED_TYPE
            depends on GEEKROS_DISPLAY_OLED
            prompt "OLED Type"
            default GEEKROS_OLED_SSD1306_128X64
            help
                Select OLED controller and resolution.
            config GEEKROS_OLED_SSD1306_128X32
                bool "SSD1306 128x32"
            config GEEKROS_OLED_SSD1306_128X64
                bool "SSD1306 128x64"
            config GEEKROS_OLED_SH1106_128X64
                bool "SH1106 128x64"
        endchoice

        # Display LCD Type
        choice GEEKROS_LCD_TYPE
            depends on GEEKROS_DISPLAY_LCD
            prompt "LCD Type"
            default GEEKROS_LCD_ST7789_240X320
            help
                Select LCD controller and resolution.
            config GEEKROS_LCD_ST7789_240X320
        bool "ST7789 240x320, IPS"

        config GEEKROS_LCD_ST7789_240X320_NO_IPS
            bool "ST7789 240x320, Non-IPS"
        config GEEKROS_LCD_ST7789_170X320
            bool "ST7789 170x320"
        config GEEKROS_LCD_ST7789_172X320
            bool "ST7789 172x320"
        config GEEKROS_LCD_ST7789_240X280
            bool "ST7789 240x280"
        config GEEKROS_LCD_ST7789_240X240
            bool "ST7789 240x240"
        config GEEKROS_LCD_ST7789_240X240_7PIN
            bool "ST7789 240x240, 7PIN"
        config GEEKROS_LCD_ST7789_240X135
            bool "ST7789 240x135"
        config GEEKROS_LCD_ST7735_128X160
            bool "ST7735 128x160"
        config GEEKROS_LCD_ST7735_128X128
            bool "ST7735 128x128"
        config GEEKROS_LCD_ST7796_320X480
            bool "ST7796 320x480, IPS"
        config GEEKROS_LCD_ST7796_320X480_NO_IPS
            bool "ST7796 320x480, Non-IPS"
        config GEEKROS_LCD_ILI9341_240X320
            bool "ILI9341 240x320"
        config GEEKROS_LCD_ILI9341_240X320_NO_IPS
            bool "ILI9341 240x320, Non-IPS"
        config GEEKROS_LCD_GC9A01_240X240
            bool "GC9A01 240x240, Circle"
        config GEEKROS_LCD_TYPE_800_1280_10_1_INCH
            bool "10.1inch 800x1280 IPS (DSI)"
        config GEEKROS_LCD_TYPE_800_1280_10_1_INCH_A
            bool "10.1inch DSI Touch A"
        config GEEKROS_LCD_TYPE_800_800_3_4_INCH
            bool "3.4inch Round 800x800"
        config GEEKROS_LCD_TYPE_720_720_4_INCH
            bool "4inch Round 720x720"
        config GEEKROS_LCD_CUSTOM
            bool "Custom LCD (User Defined)"
        endchoice
        
        choice GEEKROS_LCD_PIXEL_FORMAT
            depends on GEEKROS_DISPLAY_LCD
            prompt "LCD Pixel Format"
            default GEEKROS_LCD_PIXEL_FORMAT_RGB565
            help
                Select the pixel format for the LCD display.
            config GEEKROS_LCD_PIXEL_FORMAT_RGB565
                bool "RGB565"
            config GEEKROS_LCD_PIXEL_FORMAT_RGB888
                bool "RGB888"
        endchoice
    endmenu
endmenu
```

## sdkconfig.defaults.esp32
```kconfig
CONFIG_ESPTOOLPY_FLASHSIZE_4MB=y
CONFIG_PARTITION_TABLE_CUSTOM=y
CONFIG_PARTITION_TABLE_CUSTOM_FILENAME="tools/partitions/partition_4m.csv"
CONFIG_ESP_TASK_WDT_TIMEOUT_S=20
```

## sdkconfig.defaults.esp32s3
```kconfig
# Flash size set to 16MB
CONFIG_ESPTOOLPY_FLASHSIZE_16MB=y

# Use QIO (Quad I/O) flash mode for faster read/write
CONFIG_ESPTOOLPY_FLASHMODE_QIO=y

# Set default CPU frequency to 240 MHz (maximum for ESP32-S3)
CONFIG_ESP_DEFAULT_CPU_FREQ_MHZ_240=y

# Enable external SPI RAM (PSRAM)
CONFIG_SPIRAM=y

# Set PSRAM to Octal mode for higher bandwidth
CONFIG_SPIRAM_MODE_OCT=y

# PSRAM clock speed set to 80 MHz
CONFIG_SPIRAM_SPEED_80M=y

# Always allocate first 512 bytes in internal RAM
CONFIG_SPIRAM_MALLOC_ALWAYSINTERNAL=512

# Reserve 64 KB of internal RAM for critical allocations
CONFIG_SPIRAM_MALLOC_RESERVE_INTERNAL=65536

# Disable PSRAM memory test at boot
CONFIG_SPIRAM_MEMTEST=n

# Allow mbedTLS to use external (PSRAM) memory for allocation
CONFIG_MBEDTLS_EXTERNAL_MEM_ALLOC=y

# Number of static RX buffers for Wi-Fi
CONFIG_ESP_WIFI_STATIC_RX_BUFFER_NUM=3

# Number of dynamic RX buffers for Wi-Fi
CONFIG_ESP_WIFI_DYNAMIC_RX_BUFFER_NUM=6

# Wi-Fi Block Ack window size (buffered packets per session)
CONFIG_ESP_WIFI_RX_BA_WIN=3

# Size of TCP/IP receive message box (affects throughput)
CONFIG_LWIP_TCPIP_RECVMBOX_SIZE=16

# Allow mbedTLS to free configuration data dynamically
CONFIG_MBEDTLS_DYNAMIC_FREE_CONFIG_DATA=y

# Instruction cache size set to 32 KB
CONFIG_ESP32S3_INSTRUCTION_CACHE_32KB=y

# Data cache line size set to 64 bytes (improves performance)
CONFIG_ESP32S3_DATA_CACHE_LINE_64B=y


# Stack size for system event task (e.g., Wi-Fi events)
CONFIG_ESP_SYSTEM_EVENT_TASK_STACK_SIZE=4096


# LVGL snapshot feature enabled (for capturing screen images)
CONFIG_LV_USE_SNAPSHOT=y
```
